#include "capability_evidence_core.h"
#include "core/bus_HAL.h"
#include "core/i2c_finder.h"
#include "internal.h"
#include "modules/rfid/RFIDInterface.h"
#include <globals.h>
#if !defined(LITE_VERSION)
#include "modules/others/ibutton_core.h"
#include "modules/rfid/ST25R3916.h"
#endif
#include "modules/rfid/PN532.h"
#include "modules/rfid/RFID2.h"
#include <stdarg.h>
#include <stdio.h>
#include <string.h>
#if defined(COMPANION_HAS_NRF24)
#include "modules/NRF24/nrf_common.h"
#endif
#if defined(COMPANION_HAS_LORA)
#include "modules/lora/LoRaRF.h"
#endif

namespace brucia {
namespace companion {
#if defined(DEVICE_NAME)
#define COMPANION_BOARD_NAME DEVICE_NAME
#else
#define COMPANION_BOARD_NAME "unknown"
#endif

#if defined(BRUCE_VERSION)
#define COMPANION_FW_VERSION BRUCE_VERSION
#else
// Bump this with each firmware release so the app's Device info shows whether a reflash took
// (old firmware reports an older value / "dev"; a successful flash shows this).
#define COMPANION_FW_VERSION "dev"
#endif

// Release provenance generated by pre_build_provenance.py (gitignored header). Builds without the
// pre-script or without Git metadata report "unknown" instead of failing.
#if __has_include("brucia_build_info.h")
#include "brucia_build_info.h"
#endif
#ifndef BRUCIA_BUILD_COMMIT
#define BRUCIA_BUILD_COMMIT "unknown"
#endif
#ifndef BRUCIA_BUILD_DIRTY
#define BRUCIA_BUILD_DIRTY -1
#endif
#ifndef BRUCIA_BUILD_ID
#define BRUCIA_BUILD_ID "unknown"
#endif
#ifndef BRUCIA_BUILD_TIME
#define BRUCIA_BUILD_TIME "unknown"
#endif
#ifndef BRUCIA_BUILD_TIME_SOURCE
#define BRUCIA_BUILD_TIME_SOURCE "unknown"
#endif
#ifndef BRUCIA_BUILD_ENV
#define BRUCIA_BUILD_ENV "unknown"
#endif

static const char *companionChip() {
#if defined(CONFIG_IDF_TARGET_ESP32S3)
    return "esp32-s3";
#elif defined(CONFIG_IDF_TARGET_ESP32C6)
    return "esp32-c6";
#elif defined(CONFIG_IDF_TARGET_ESP32C5)
    return "esp32-c5";
#elif defined(CONFIG_IDF_TARGET_ESP32C3)
    return "esp32-c3";
#else
    return "esp32";
#endif
}

// CAPABILITY-PROBE CACHING (reboot fix) AND EVIDENCE.
// The CC1101, NRF24 and W5500 probes drive SPI. On the T-Embed CC1101 the CC1101, the SD card,
// the NRF24, the W5500 AND the TFT display all share ONE physical SPI bus (same SCK/MISO/MOSI
// pins; NRF24 and W5500 even share CS pin 44), so acquireSPIBus() hands these probes the
// DISPLAY's live SPIClass instance. The companion app retries HELLO until it gets a CAPS reply,
// so probing from sendCaps() would churn the shared display bus many times back-to-back - the
// prime cause of the reported "ESP reboots while connected". Fix: every electronic probe runs
// at most ONCE per boot, inside the serialized warm window at companion entry (before the
// status screen's redraw loop and before any stream can start), and its result is cached for
// every later CAPS and for the nrf24_*/eth command gates. Hardware does not hot-plug at runtime.
//
// Each probe also records evidence for CAPS d.evidence (see capability_evidence_core.h and
// proto/PROTOCOL.md): whether a bus transaction saw the chip (probed), whether the driver was
// brought up (initialized), or why nothing was checked. A probe that has not run when the warm
// window is closed reports "busy" instead of taking a bus a running stream may own; it stays
// uncached so the next companion entry retries it. A pin assignment or a saved reader selection
// is never reported as a probe.

namespace {
enum ProbeId : uint8_t { PR_CC1101 = 0, PR_NFC, PR_NRF24, PR_FM, PR_LORA, PR_ETH, PR_COUNT };

struct ProbeRecord {
    bool cached = false;
    ProbeOutcome probe = ProbeOutcome::NotRun;
    bool initialized = false;
    char detail[64] = {0};
};

ProbeRecord s_probe[PR_COUNT];
bool s_probeWindow = false; // true only inside companionWarmCaps()

void setDetail(ProbeRecord &r, const char *fmt, ...) {
    va_list args;
    va_start(args, fmt);
    vsnprintf(r.detail, sizeof(r.detail), fmt, args);
    va_end(args);
}

// Run fn(record) once inside the warm window and cache it. Outside the window an un-run probe
// reports busy without touching any bus.
template <typename Fn> bool runProbeOnce(ProbeId id, Fn fn) {
    ProbeRecord &r = s_probe[id];
    if (!r.cached) {
        if (!s_probeWindow) {
            r.probe = ProbeOutcome::Busy;
            setDetail(r, "not probed: bus may be owned by an active stream");
            return false;
        }
        r = ProbeRecord();
        r.cached = true;
        fn(r);
        if (r.probe == ProbeOutcome::Busy) r.cached = false; // retry at the next companion entry
    }
    return r.probe == ProbeOutcome::Present;
}

bool spiPinsSet(const BruceConfigPins::SPIPins &p) {
    return p.sck != GPIO_NUM_NC && p.miso != GPIO_NUM_NC && p.mosi != GPIO_NUM_NC && p.cs != GPIO_NUM_NC;
}
} // namespace

// --- CC1101: bounded PARTNUM/VERSION status-register read (no strobes, no config writes). ---
static bool cc1101Configured() {
#if defined(COMPANION_HAS_CC1101)
    return spiPinsSet(bruceConfigPins.CC1101_bus);
#else
    return false;
#endif
}

static void probeCc1101(ProbeRecord &r) {
#if defined(COMPANION_HAS_CC1101)
    if (!cc1101Configured()) {
        setDetail(r, "SPI pins not configured");
        return;
    }
    const auto &pins = bruceConfigPins.CC1101_bus;
    SPIClass *spi = acquireSPIBus(pins.sck, pins.miso, pins.mosi);
    if (!spi) {
        setDetail(r, "not probed: SPI bus unavailable");
        return;
    }
    pinMode(pins.cs, OUTPUT);
    digitalWrite(pins.cs, HIGH);
    spi->beginTransaction(SPISettings(4000000, MSBFIRST, SPI_MODE0));
    digitalWrite(pins.cs, LOW);
    // CHIP_RDYn (MISO low) once the crystal runs. Never wait indefinitely on an empty socket.
    uint32_t started = millis();
    while (digitalRead(pins.miso) == HIGH && millis() - started < 5) delay(1);
    bool present = false;
    if (digitalRead(pins.miso) == LOW) {
        spi->transfer(0xF0); // PARTNUM status register: read + burst bits
        uint8_t part = spi->transfer(0);
        digitalWrite(pins.cs, HIGH);
        digitalWrite(pins.cs, LOW);
        spi->transfer(0xF1); // VERSION status register
        uint8_t version = spi->transfer(0);
        present = part == 0 && version != 0 && version != 0xFF;
        setDetail(r, "SPI PARTNUM 0x%02X VERSION 0x%02X", part, version);
    } else {
        setDetail(r, "no CHIP_RDYn on MISO within 5 ms");
    }
    digitalWrite(pins.cs, HIGH);
    spi->endTransaction();
    r.probe = present ? ProbeOutcome::Present : ProbeOutcome::Absent;
#else
    (void)r;
#endif
}

static bool companionCc1101Present() { return runProbeOnce(PR_CC1101, probeCc1101); }

// --- W5500: VERSIONR read (common register 0x0039 is 0x04 on a real W5500; read-only frame). ---
static bool w5500Configured() {
#if defined(COMPANION_HAS_ETH)
    return spiPinsSet(bruceConfigPins.W5500_bus);
#else
    return false;
#endif
}

static void probeW5500(ProbeRecord &r) {
#if defined(COMPANION_HAS_ETH)
    if (!w5500Configured()) {
        setDetail(r, "SPI pins not configured");
        return;
    }
    // SILENT (no Serial.println) so it never injects stray bytes into the framed protocol.
    pinMode(bruceConfigPins.W5500_bus.cs, OUTPUT);
    digitalWrite(bruceConfigPins.W5500_bus.cs, HIGH);
    delay(2); // let the CS settle before SPI traffic
    SPIClass *spi = acquireSPIBus(
        bruceConfigPins.W5500_bus.sck, bruceConfigPins.W5500_bus.miso, bruceConfigPins.W5500_bus.mosi
    );
    if (!spi) spi = &SPI;
    // W5500 VDM read frame: 16-bit address (0x0039) + control byte (BSB=0 common reg, RWB=0 read,
    // OM=00 VDM -> 0x00), then clock out one byte. Wrapped in begin/endTransaction so the shared
    // display/SD bus is left in a clean state (its next owner re-applies its own SPISettings).
    spi->beginTransaction(SPISettings(8000000, MSBFIRST, SPI_MODE0));
    digitalWrite(bruceConfigPins.W5500_bus.cs, LOW);
    spi->transfer(0x00);
    spi->transfer(0x39);
    spi->transfer(0x00);
    uint8_t version = spi->transfer(0x00);
    digitalWrite(bruceConfigPins.W5500_bus.cs, HIGH);
    spi->endTransaction();
    r.probe = version == 0x04 ? ProbeOutcome::Present : ProbeOutcome::Absent;
    setDetail(r, "SPI VERSIONR 0x%02X (W5500 = 0x04)", version);
#else
    (void)r;
#endif
}

static bool companionW5500Present() { return runProbeOnce(PR_ETH, probeW5500); }

// --- NRF24: RF24 register readback, then power down (CE stays low: no TX/RX). ---
static bool nrf24Configured() {
#if defined(COMPANION_HAS_NRF24)
    return !bruceConfigPins.NRF24_bus.checkConflict(GPIO_NUM_NC) && bruceConfigPins.NRF24_bus.io0 != GPIO_NUM_NC;
#else
    return false;
#endif
}

static void probeNrf24(ProbeRecord &r) {
#if defined(COMPANION_HAS_NRF24)
    if (!nrf24Configured()) {
        setDetail(r, "SPI/CE pins not configured");
        return;
    }
#if defined(COMPANION_HAS_ETH)
    // RF24 begin() WRITES registers. When a W5500 already answered on the same chip select, those
    // writes would land in the W5500, so the NRF24 is not probed (the two cannot share one CS).
    if (bruceConfigPins.NRF24_bus.cs == bruceConfigPins.W5500_bus.cs &&
        s_probe[PR_ETH].probe == ProbeOutcome::Present) {
        setDetail(r, "not probed: CS shared with detected W5500");
        return;
    }
#endif
    // Mirrors nrf_common.cpp's SPI bring-up but stays SILENT (no Serial.println).
    pinMode(bruceConfigPins.NRF24_bus.cs, OUTPUT);
    digitalWrite(bruceConfigPins.NRF24_bus.cs, HIGH);
    pinMode(bruceConfigPins.NRF24_bus.io0, OUTPUT);
    digitalWrite(bruceConfigPins.NRF24_bus.io0, LOW);
    delay(5); // let pins settle before SPI traffic
    SPIClass *spi = acquireSPIBus(
        bruceConfigPins.NRF24_bus.sck, bruceConfigPins.NRF24_bus.miso, bruceConfigPins.NRF24_bus.mosi
    );
    if (!spi) spi = &SPI;
    if (!NRFradio.begin(
            spi, rf24_gpio_pin_t(bruceConfigPins.NRF24_bus.io0), rf24_gpio_pin_t(bruceConfigPins.NRF24_bus.cs)
        )) {
        r.probe = ProbeOutcome::Absent;
        setDetail(r, "RF24 begin: no valid register readback");
        return;
    }
    // isChipConnected() reads SETUP_AW; a floating MISO reads back out of range.
    bool present = NRFradio.isChipConnected();
    NRFradio.powerDown(); // leave the radio in its power-on (powered down) state, CS deselected
    r.probe = present ? ProbeOutcome::Present : ProbeOutcome::Absent;
    setDetail(r, present ? "SPI SETUP_AW readback valid; left powered down" : "SPI SETUP_AW readback invalid");
#else
    (void)r;
#endif
}

bool companionNrf24Present() { return runProbeOnce(PR_NRF24, probeNrf24); }

// --- NFC reader: the selected reader's identification/initialization. ---
static bool nfcConfigured() {
    const auto module = bruceConfigPins.rfidModule;
    if (module == PN532_SPI_MODULE) return !bruceConfigPins.PN532_bus.checkConflict(GPIO_NUM_NC);
    if (module == PN532_I2C_SPI_MODULE) {
#ifdef M5STICK
        return true;
#else
        return false;
#endif
    }
#if !defined(LITE_VERSION)
    if (module == ST25R3916_SPI_MODULE) return !bruceConfigPins.ST25R_bus.checkConflict(GPIO_NUM_NC);
#endif
    if (module == RC522_SPI_MODULE) return true; // fixed board SPI pins
    return !bruceConfigPins.i2c_bus.checkConflict(GPIO_NUM_NC);
}

static const char *nfcModuleName(int module) {
    switch (module) {
        case PN532_I2C_MODULE: return "PN532 I2C";
        case PN532_SPI_MODULE: return "PN532 SPI";
        case PN532_I2C_SPI_MODULE: return "PN532 I2C/SPI";
        case RC522_SPI_MODULE: return "RC522 SPI";
#if !defined(LITE_VERSION)
        case ST25R3916_SPI_MODULE: return "ST25R3916 SPI";
        case ST25R3916_I2C_MODULE: return "ST25R3916 I2C";
#endif
        case M5_RFID2_MODULE: return "RFID2 (MFRC522 I2C)";
        default: return "reader";
    }
}

static void probeNfc(ProbeRecord &r) {
    const auto module = bruceConfigPins.rfidModule;
    const char *name = nfcModuleName(module);
    if (!nfcConfigured()) {
        setDetail(r, "%s: pins not configured", name);
        return;
    }
    if (module == PN532_I2C_MODULE || module == PN532_SPI_MODULE || module == PN532_I2C_SPI_MODULE) {
        PN532::CONNECTION_TYPE type = PN532::I2C;
        if (module == PN532_SPI_MODULE) type = PN532::SPI;
#ifdef M5STICK
        else if (module == PN532_I2C_SPI_MODULE) type = PN532::I2C_SPI;
#endif
        PN532 reader(type);
        // Reset/wake plus GetFirmwareVersion. The RF field is not enabled.
        const bool present = reader.probe();
        const uint32_t v = reader.firmwareVersion();
        r.probe = present ? ProbeOutcome::Present : ProbeOutcome::Absent;
        if (present)
            setDetail(r, "%s firmware IC 0x%02X v%u.%u", name, (unsigned)((v >> 24) & 0xFF),
                      (unsigned)((v >> 16) & 0xFF), (unsigned)((v >> 8) & 0xFF));
        else
            setDetail(r, "%s: no firmware response", name);
        return;
    }
    RFIDInterface *reader = createCompanionRfidModule();
    const bool ok = reader && reader->begin();
    if (ok && (module == M5_RFID2_MODULE || module == RC522_SPI_MODULE)) {
        // MFRC522 PCD_Init() enables the antenna driver; switch the field off again.
        static_cast<RFID2 *>(reader)->mfrc522.PCD_AntennaOff();
    }
    delete reader; // the ST25R3916 destructor powers the reader down
    r.probe = ok ? ProbeOutcome::Present : ProbeOutcome::Absent;
    r.initialized = ok; // begin() identified the chip and brought the driver up
    setDetail(r, ok ? "%s driver begin ok (chip identified)" : "%s: driver begin failed", name);
}

static bool companionNfcPresent() { return runProbeOnce(PR_NFC, probeNfc); }

// --- FM (Si4713): I2C address ACK at 0x63 only; no register is written. ---
static bool fmConfigured() {
#if defined(COMPANION_HAS_FM)
    return !bruceConfigPins.i2c_bus.checkConflict(GPIO_NUM_NC);
#else
    return false;
#endif
}

static void probeFm(ProbeRecord &r) {
#if defined(COMPANION_HAS_FM)
    if (!fmConfigured()) {
        setDetail(r, "I2C pins not configured");
        return;
    }
    const bool ack = check_i2c_address(0x63);
    r.probe = ack ? ProbeOutcome::Present : ProbeOutcome::Absent;
    setDetail(r, ack ? "I2C ACK at 0x63 (address only, no chip ID)" : "no I2C ACK at 0x63");
#else
    (void)r;
#endif
}

static bool companionFmPresent() { return runProbeOnce(PR_FM, probeFm); }

// --- LoRa: RadioLib begin() (chip version check + configuration), then sleep; no RX/TX. ---
static bool loraConfigured() {
#if defined(COMPANION_HAS_LORA)
    return spiPinsSet(bruceConfigPins.LoRa_bus);
#else
    return false;
#endif
}

static void probeLora(ProbeRecord &r) {
#if defined(COMPANION_HAS_LORA)
    if (!loraConfigured()) {
        setDetail(r, "SPI pins not configured");
        return;
    }
    if (lora_companion_ready()) {
        r.probe = ProbeOutcome::Busy;
        setDetail(r, "not probed: a LoRa session owns the radio");
        return;
    }
    bool sx1262 = false;
    const bool ok = lora_companion_probe(&sx1262);
    const char *chip = sx1262 ? "SX1262" : "SX1276";
    r.probe = ok ? ProbeOutcome::Present : ProbeOutcome::Absent;
    r.initialized = ok;
    setDetail(r, ok ? "RadioLib %s begin ok; left asleep" : "RadioLib %s begin failed", chip);
#else
    (void)r;
#endif
}

static bool companionLoraPresent() { return runProbeOnce(PR_LORA, probeLora); }

// Warm the probe caches ONCE, from a single serialized point at companion entry, before the
// status screen's redraw loop and before any stream subscription. The W5500 read-only probe runs
// before the NRF24 one because RF24 begin() writes registers and the two may share a CS.
void companionWarmCaps() {
    s_probeWindow = true;
    (void)companionCc1101Present();
    (void)companionNfcPresent();
    (void)companionLoraPresent();
    (void)companionW5500Present();
    (void)companionNrf24Present();
    (void)companionFmPresent();
    s_probeWindow = false;
}

// --- Static pin/bus conflicts from the active pin configuration (no bus traffic). ---
namespace {
struct PinList {
    PinUse uses[64];
    size_t count = 0;
    void add(const char *module, const char *role, int gpio, PinShare share) {
        if (gpio < 0 || count >= sizeof(uses) / sizeof(uses[0])) return;
        uses[count++] = PinUse{module, role, gpio, share};
    }
    void addSpi(const char *module, const BruceConfigPins::SPIPins &p) {
        add(module, "sck", p.sck, PinShare::SpiBus);
        add(module, "miso", p.miso, PinShare::SpiBus);
        add(module, "mosi", p.mosi, PinShare::SpiBus);
        add(module, "cs", p.cs, PinShare::Exclusive);
    }
    void addI2c(const char *module, const BruceConfigPins::I2CPins &p) {
        add(module, "sda", p.sda, PinShare::I2cBus);
        add(module, "scl", p.scl, PinShare::I2cBus);
    }
};

void collectPinUses(PinList &l) {
#if defined(COMPANION_HAS_CC1101)
    l.addSpi("cc1101", bruceConfigPins.CC1101_bus);
    l.add("cc1101", "gdo0", bruceConfigPins.CC1101_bus.io0, PinShare::Exclusive);
    l.add("cc1101", "gdo2", bruceConfigPins.CC1101_bus.io2, PinShare::Exclusive);
#if defined(CC1101_SW0_PIN) && defined(CC1101_SW1_PIN)
    l.add("cc1101", "sw0", CC1101_SW0_PIN, PinShare::Exclusive);
    l.add("cc1101", "sw1", CC1101_SW1_PIN, PinShare::Exclusive);
#endif
#endif
#if defined(COMPANION_HAS_NRF24)
    l.addSpi("nrf24", bruceConfigPins.NRF24_bus);
    l.add("nrf24", "ce", bruceConfigPins.NRF24_bus.io0, PinShare::Exclusive);
#endif
#if defined(COMPANION_HAS_ETH)
    l.addSpi("eth", bruceConfigPins.W5500_bus);
    l.add("eth", "int", bruceConfigPins.W5500_bus.io0, PinShare::Exclusive);
    l.add("eth", "rst", bruceConfigPins.W5500_bus.io2, PinShare::Exclusive);
#endif
#if defined(COMPANION_HAS_LORA)
    l.addSpi("lora", bruceConfigPins.LoRa_bus);
    l.add("lora", "rst", bruceConfigPins.LoRa_bus.io0, PinShare::Exclusive);
    l.add("lora", "dio0", bruceConfigPins.LoRa_bus.io2, PinShare::Exclusive);
#endif
    const auto module = bruceConfigPins.rfidModule;
    if (module == PN532_SPI_MODULE) {
        l.addSpi("nfc", bruceConfigPins.PN532_bus);
#if !defined(LITE_VERSION)
    } else if (module == ST25R3916_SPI_MODULE) {
        l.addSpi("nfc", bruceConfigPins.ST25R_bus);
        l.add("nfc", "irq", bruceConfigPins.ST25R_bus.io0, PinShare::Exclusive);
#endif
    } else if (module == RC522_SPI_MODULE) {
#if defined(SPI_SCK_PIN) && defined(SPI_MISO_PIN) && defined(SPI_MOSI_PIN) && defined(SPI_SS_PIN)
        l.add("nfc", "sck", SPI_SCK_PIN, PinShare::SpiBus);
        l.add("nfc", "miso", SPI_MISO_PIN, PinShare::SpiBus);
        l.add("nfc", "mosi", SPI_MOSI_PIN, PinShare::SpiBus);
        l.add("nfc", "cs", SPI_SS_PIN, PinShare::Exclusive);
#endif
    } else if (module != PN532_I2C_SPI_MODULE) {
        l.addI2c("nfc", bruceConfigPins.i2c_bus);
#if defined(PN532_IRQ) && defined(PN532_RF_REST)
        if (module == PN532_I2C_MODULE) {
            l.add("nfc", "irq", PN532_IRQ, PinShare::Exclusive);
            l.add("nfc", "rst", PN532_RF_REST, PinShare::Exclusive);
        }
#endif
    }
#if defined(COMPANION_HAS_FM)
    l.addI2c("fm", bruceConfigPins.i2c_bus);
#endif
#if !defined(USE_SD_MMC)
    l.addSpi("sd", bruceConfigPins.SDCARD_bus);
#endif
#if defined(HAS_SCREEN) && defined(TFT_CS)
#if defined(TFT_SCLK) && defined(TFT_MOSI)
    l.add("display", "sck", TFT_SCLK, PinShare::SpiBus);
    l.add("display", "mosi", TFT_MOSI, PinShare::SpiBus);
#endif
#if defined(TFT_MISO)
    l.add("display", "miso", TFT_MISO, PinShare::SpiBus);
#endif
    l.add("display", "cs", TFT_CS, PinShare::Exclusive);
#if defined(TFT_DC)
    l.add("display", "dc", TFT_DC, PinShare::Exclusive);
#endif
#if defined(TFT_RST)
    l.add("display", "rst", TFT_RST, PinShare::Exclusive);
#endif
#endif
#if defined(COMPANION_HAS_IR)
    l.add("ir", "tx", bruceConfigPins.irTx, PinShare::Exclusive);
    l.add("ir", "rx", bruceConfigPins.irRx, PinShare::Exclusive);
#endif
#if defined(COMPANION_HAS_MIC)
#if defined(PIN_CLK)
    l.add("mic", "clk", PIN_CLK, PinShare::Exclusive);
#endif
#if defined(PIN_DATA)
    l.add("mic", "data", PIN_DATA, PinShare::Exclusive);
#endif
#if defined(PIN_BCLK)
    l.add("mic", "bclk", PIN_BCLK, PinShare::Exclusive);
#endif
#endif
#if defined(HAS_NS4168_SPKR)
#if defined(BCLK)
    l.add("speaker", "bclk", BCLK, PinShare::Exclusive);
#endif
#if defined(WCLK)
    l.add("speaker", "wclk", WCLK, PinShare::Exclusive);
#endif
#if defined(DOUT)
    l.add("speaker", "dout", DOUT, PinShare::Exclusive);
#endif
#if defined(MCLK)
    l.add("speaker", "mclk", MCLK, PinShare::Exclusive);
#endif
#endif
#if !defined(LITE_VERSION)
    if (ibuttonPinUsable(bruceConfigPins.iButton, GPIO_NUM_MAX))
        l.add("ibutton", "data", bruceConfigPins.iButton, PinShare::Exclusive);
#endif
}
} // namespace

// Write one module's evidence; conflicts mentioning it are attached as `conflict`.
static void writeEvidence(
    JsonObject ev, const char *module, const EvidenceInputs &in, const char *detail, const PinList &pins,
    const PinConflict *conflicts, size_t conflictCount
) {
    JsonObject m = ev[module].to<JsonObject>();
    m["level"] = evidenceLevelName(resolveEvidenceLevel(in));
    if (const char *probe = probeOutcomeName(in.probe)) m["probe"] = probe;
    if (detail && detail[0]) m["detail"] = detail;
    JsonArray list;
    for (size_t i = 0; i < conflictCount; i++) {
        const PinUse &a = pins.uses[conflicts[i].a];
        const PinUse &b = pins.uses[conflicts[i].b];
        const PinUse *self = nullptr, *other = nullptr;
        if (strcmp(a.module, module) == 0) self = &a, other = &b;
        else if (strcmp(b.module, module) == 0) self = &b, other = &a;
        if (!self) continue;
        if (list.isNull()) list = m["conflict"].to<JsonArray>();
        JsonObject c = list.add<JsonObject>();
        c["gpio"] = self->gpio;
        c["role"] = self->role;
        c["with"] = other->module;
        c["with_role"] = other->role;
    }
}

static EvidenceInputs probedInputs(ProbeId id, bool compiled, bool configured) {
    EvidenceInputs in;
    in.compiled = compiled;
    in.configured = configured;
    in.probe = s_probe[id].probe;
    in.initialized = s_probe[id].initialized;
    return in;
}

static EvidenceInputs fixedInputs(bool compiled, bool configured) {
    EvidenceInputs in;
    in.compiled = compiled;
    in.configured = compiled && configured;
    return in;
}

#if defined(COMPANION_HAS_CC1101)
static constexpr bool kHasCc1101 = true;
#else
static constexpr bool kHasCc1101 = false;
#endif
#if defined(COMPANION_HAS_NRF24)
static constexpr bool kHasNrf24 = true;
#else
static constexpr bool kHasNrf24 = false;
#endif
#if defined(COMPANION_HAS_FM)
static constexpr bool kHasFm = true;
#else
static constexpr bool kHasFm = false;
#endif
#if defined(COMPANION_HAS_LORA)
static constexpr bool kHasLora = true;
#else
static constexpr bool kHasLora = false;
#endif
#if defined(COMPANION_HAS_ETH)
static constexpr bool kHasEth = true;
#else
static constexpr bool kHasEth = false;
#endif

static void writeEvidenceMap(JsonObject d) {
    static PinList pins; // static: keeps ~1 KB off the loop task stack
    pins = PinList();
    collectPinUses(pins);
    PinConflict conflicts[32];
    size_t found = findPinConflicts(pins.uses, pins.count, conflicts, 32);
    if (found > 32) found = 32;

    JsonObject ev = d["evidence"].to<JsonObject>();
    auto probed = [&](const char *name, ProbeId id, bool compiled, bool configured) {
        writeEvidence(ev, name, probedInputs(id, compiled, configured), s_probe[id].detail, pins, conflicts, found);
    };
    auto fixed = [&](const char *name, bool compiled, bool configured, const char *detail) {
        writeEvidence(ev, name, fixedInputs(compiled, configured), detail, pins, conflicts, found);
    };

    fixed("wifi", true, false, "ESP32 SoC radio; driver starts per operation");
    fixed("ble", true, false, "ESP32 SoC radio; driver starts per operation");
    // Uniform for every board: a module not built for this env resolves to level "none".
    probed("cc1101", PR_CC1101, kHasCc1101, cc1101Configured());
    probed("nfc", PR_NFC, true, nfcConfigured());
    probed("nrf24", PR_NRF24, kHasNrf24, nrf24Configured());
    probed("fm", PR_FM, kHasFm, fmConfigured());
    probed("lora", PR_LORA, kHasLora, loraConfigured());
    probed("eth", PR_ETH, kHasEth, w5500Configured());
#if defined(COMPANION_HAS_IR)
    fixed("ir", true, bruceConfigPins.irTx >= 0 || bruceConfigPins.irRx >= 0, "GPIO only; no chip identification");
#else
    fixed("ir", false, false, nullptr);
#endif
#if defined(COMPANION_HAS_MIC)
    fixed("mic", true, true, "board profile pins; no chip identification");
#else
    fixed("mic", false, false, nullptr);
#endif
#if defined(HAS_NS4168_SPKR)
    fixed("speaker", true, true, "board profile I2S pins; no chip identification");
#else
    fixed("speaker", false, false, nullptr);
#endif
#if !defined(LITE_VERSION)
    fixed("ibutton", true, ibuttonPinUsable(bruceConfigPins.iButton, GPIO_NUM_MAX),
          "1-Wire answers only with a key present; not probed");
#else
    fixed("ibutton", false, false, nullptr);
#endif
    // SD: the mount state is live (mounted by Bruce, no probe of ours). Not mounted cannot be told
    // apart from an unreadable or unformatted card, so it is not reported as probed absent.
    {
        EvidenceInputs in;
        in.compiled = true;
#if defined(USE_SD_MMC)
        in.configured = true;
#else
        in.configured = spiPinsSet(bruceConfigPins.SDCARD_bus);
#endif
        in.probe = sdcardMounted ? ProbeOutcome::Present : ProbeOutcome::NotRun;
        writeEvidence(ev, "sd", in, sdcardMounted ? "card mounted" : "not mounted (no card, format or mount failure)",
                      pins, conflicts, found);
    }
}

void sendCaps(uint32_t id) {
    JsonDocument out;
    beginEnvelope(out, MSG_CAPS, id);
    JsonObject d = out["d"].to<JsonObject>();
    d["board"] = COMPANION_BOARD_NAME;
    d["chip"] = companionChip();
    d["fw"] = COMPANION_FW_VERSION;
    d["proto"] = BRUCIA_PROTO_VERSION;

    // Real per-peripheral capability detection (hybrid: compile-time board macros for onboard
    // fixed peripherals, quick runtime probes for the optional/uncertain ones). The app uses
    // this to show/hide features. wifi/ble are always present on these ESP32 targets.
    JsonObject caps = d["caps"].to<JsonObject>();
    caps["cc1101"] = companionCc1101Present();
    caps["nfc"] = companionNfcPresent();
    caps["nrf24"] = companionNrf24Present();
    // FM (Si4713): runtime I2C probe at 0x63 (cached). Absent on the T-Embed/CYD -> fm:false.
    caps["fm"] = companionFmPresent();
#if defined(TXLED) || defined(RXLED) || defined(IR_RX_PINS) || defined(IR_TX_PINS)
    caps["ir"] = true; // onboard IR RX/TX pins (compile-time board macros)
#else
    caps["ir"] = false;
#endif
#if defined(COMPANION_HAS_MIC)
    caps["mic"] = true; // MIC_SPM1423 / MIC_INMP441 (compile-time board macro)
#else
    caps["mic"] = false;
#endif
#if defined(HAS_NS4168_SPKR)
    caps["speaker"] = true; // NS4168 I2S speaker (compile-time board macro)
#else
    caps["speaker"] = false;
#endif
    caps["lora"] = companionLoraPresent();
    // Ethernet (W5500): runtime SPI probe (false when no module is actually attached / not wired).
    caps["eth"] = companionW5500Present();
#if !defined(LITE_VERSION)
    // iButton: configured pin only, not probed (a 1-Wire bus answers only with a key present).
    caps["ibutton"] = ibuttonPinUsable(bruceConfigPins.iButton, GPIO_NUM_MAX);
#else
    caps["ibutton"] = false;
#endif
    caps["wifi"] = true;
    caps["ble"] = true;
    d["features"]["verified_files"] = true; // correlated chunks, size/CRC32 completion, empty/spaced writes
    d["features"]["transactional_uploads"] = true; // staged + size/CRC commit; FAT recovery journal
    d["features"]["mifare_keycheck_report"] = true; // mifare_keycheck ACK carries v1 complete/partial + UID
#if defined(HAS_NS4168_SPKR)
    // speaker_play ACKs at start (d.play) and ends with one EVENT ev="speaker.play"; speaker_stop stops it.
    d["features"]["speaker_play_async"] = true;
#endif
    d["features"]["mifare_keycheck_stop"] = true;   // in-flight mifare_keycheck batch stops on a polled stop frame
    d["features"]["diag"] = true; // `diag` CMD: reset reason, heap and bounded link/drop counters on request
#if !defined(LITE_VERSION)
    // wifi_handshake/wifi_pmkid terminal ACK carries d.desc{v,path,size,crc32,frames,complete,stop,...}
    // for the file written this run; the phone imports exactly that path and verifies it after transfer.
    d["features"]["capture_descriptor"] = true;
#endif

    // Per-module evidence (additive): compiled / configured / probed / initialized, the probe
    // outcome (present / absent / busy), a short detail and static pin conflicts. caps above stays
    // the gating map; evidence explains it. Never claims a physical test.
    writeEvidenceMap(d);

    // Release provenance (additive): ties a report to the exact artifact. fw/proto/features above
    // are not repeated here. dirty is omitted when Git state was unavailable at build time.
    JsonObject build = d["build"].to<JsonObject>();
    build["commit"] = BRUCIA_BUILD_COMMIT;
#if BRUCIA_BUILD_DIRTY >= 0
    build["dirty"] = BRUCIA_BUILD_DIRTY == 1;
#endif
    build["id"] = BRUCIA_BUILD_ID;
    build["time"] = BRUCIA_BUILD_TIME;
    build["time_src"] = BRUCIA_BUILD_TIME_SOURCE;
    build["env"] = BRUCIA_BUILD_ENV;

    // Legacy coarse module list (kept for backward compatibility with older app builds).
    JsonArray modules = d["modules"].to<JsonArray>();
    modules.add("wifi");
    modules.add("ble");
    if (caps["cc1101"].as<bool>()) modules.add("rf");
    if (caps["ir"].as<bool>()) modules.add("ir");
    JsonArray transports = d["transports"].to<JsonArray>();
    transports.add("usb");
    d["mtu"] = COMPANION_MAX_FRAME;
    d["battery"] = getBattery();
    // Brucia: report the device UI theme so the app can match it (the device always wins). priColor
    // is RGB565; ledColor is 0xRRGGBB. The app re-themes its accent + flame to priColor on connect.
    d["theme"] = (uint32_t)bruceConfig.priColor;
#ifdef HAS_RGB_LED
    d["led"] = (uint32_t)bruceConfig.ledColor;
    d["ledBright"] = (int)bruceConfig.ledBright; // 0..100, so the app's slider shows the real value
    d["ledEffect"] = (int)bruceConfig.ledEffect; // 0..9
#endif
    d["bright"] = (int)bruceConfig.bright; // screen brightness 0..100
    sendEnvelope(out);
}

} // namespace companion
} // namespace brucia
